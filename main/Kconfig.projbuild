## main/Kconfig.projbuild
```kconfig
menu "lastDSMRlogger P1 Interface"

    comment "The P1 port is fixed on UART0 (RX GPIO44, TX GPIO43)."

    comment "P1 RX polarity is configured at runtime in the SPA (Settings view, Normal / Inverted)."

    comment "The P1 request signal is externally enabled in this release."

endmenu
```
